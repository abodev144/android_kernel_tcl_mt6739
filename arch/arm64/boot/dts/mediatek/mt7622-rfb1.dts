
/dts-v1/;
#include "mediatek/mt7622.dtsi"

/ {
	model = "MediaTek MT7622 RFB1 board";
	compatible = "mediatek,mt7622-rfb1", "mediatek,mt7622";

	chosen {
		bootargs = "console=ttyS0,115200n1";
	};

	memory {
		reg = <0 0x40000000 0 0x3F000000>;
	};
};

&uart0 {
	status = "okay";
};
